## conf/machine/include/vuplus-modules.inc
```bitbake
#
# Kernel Modules
#

KERNEL_3G_MODULES = " \
        kernel-module-ppp-async \
        kernel-module-ppp-deflate \
        kernel-module-ppp-synctty \
        kernel-module-ppp-generic \
        kernel-module-slhc \
        kernel-module-usbserial \
        "

KERNEL_WIFI_MODULES = " \
	kernel-module-ath9k-htc \
	kernel-module-carl9170 \
	kernel-module-prism2-usb \
	kernel-module-rt73usb \
	kernel-module-rt2500usb \
	kernel-module-r8192u-usb \
	kernel-module-rtl8192cu \
	kernel-module-rtl8187 \
	kernel-module-r8712u \
	kernel-module-w35und \
	kernel-module-zd1211rw \
	${@base_contains("MACHINE_FEATURES", "rt3070-legacy", "", "kernel-module-rt2800usb", d)} \
	kernel-module-llc \
        kernel-module-stp \
        kernel-module-bridge \
        kernel-module-hostap \
	"

KERNEL_DVB_MODULES = " \
	kernel-module-em28xx-dvb \
	kernel-module-dvb-usb-a800 \
	kernel-module-dvb-usb-af9005 \
	kernel-module-af9013 kernel-module-mt2060 kernel-module-qt1010 kernel-module-tda18271 kernel-module-mxl5005s kernel-module-mc44s803 kernel-module-tda18218 kernel-module-mxl5007t kernel-module-dvb-usb-af9015 \
	kernel-module-mxl5007t kernel-module-tda18218 \
	kernel-module-tda10021 kernel-module-tda10023 kernel-module-mt352 kernel-module-zl10353 kernel-module-tda18212 kernel-module-cx24116 kernel-module-stv0900 kernel-module-stv6110 kernel-module-stv6110x kernel-module-isl6423 kernel-module-dvb-usb-anysee \
	kernel-module-zl10353 kernel-module-qt1010 kernel-module-dvb-usb-au6610 \
	kernel-module-dvb-usb-az6027 \
	kernel-module-zl10353 kernel-module-mxl5005s  kernel-module-dvb-usb-ce6230 \
	kernel-module-lgdt330x kernel-module-mt352 kernel-module-zl10353 kernel-module-tuner-xc2028 kernel-module-tuner-simple kernel-module-mxl5005s kernel-module-max2165 kernel-module-lgs8gxx kernel-module-atbm8830 kernel-module-dvb-usb-cxusb kernel-module-drxd \
	kernel-module-dvb-usb-cinergyt2 \
	kernel-module-mt352 kernel-module-nxt6000 kernel-module-dvb-usb-digitv \
	kernel-module-mt2060 kernel-module-mt2266 kernel-module-tuner-xc2028 kernel-module-xc5000 kernel-module-xc4000 kernel-module-s5h1411 kernel-module-lgdt3305 kernel-module-mxl5007t kernel-module-dvb-usb-dib0700 \
	kernel-module-dvb-usb-dibusb-mb \
	kernel-module-dvb-usb-dibusb-mc \
	kernel-module-zl10353 kernel-module-qt1010 kernel-module-dvb-usb-dtv5100 \
	kernel-module-dvb-usb-dtt200u \
	kernel-module-si21xx kernel-module-stv0299 kernel-module-stv0288 kernel-module-stb6000 kernel-module-cx24116 \
	kernel-module-mt312 kernel-module-zl10039 kernel-module-ds3000 kernel-module-stv0900 kernel-module-stv6110 kernel-module-dvb-usb-dw2102 \
	kernel-module-ec100 kernel-module-mxl5005s kernel-module-dvb-usb-ec168 \
	kernel-module-zl10353 kernel-module-qt1010 kernel-module-dvb-usb-gl861 \
	kernel-module-dvb-usb-gp8psk \
	kernel-module-mt352 kernel-module-qt1010 kernel-module-tda1004x kernel-module-tda827x kernel-module-dvb-usb-m920x \
	kernel-module-stv0299 kernel-module-dvb-usb-opera \
	kernel-module-stv090x kernel-module-dvb-usb-technisat-usb2 \
	kernel-module-tda826x kernel-module-tda10086 kernel-module-tda827x kernel-module-lnbp21 kernel-module-dvb-usb-ttusb2 \
	kernel-module-dvb-ttusb-budget \
	kernel-module-dvb-usb-nova-t-usb2 \
	kernel-module-mt352 kernel-module-dvb-usb-umt-010 \
	kernel-module-dvb-usb-vp702x \
	kernel-module-dvb-usb-vp7045 \
	kernel-module-smsdvb kernel-module-smsusb \
	"
```

## conf/machine/include/vuplus-modules2.inc
```bitbake
#
# Kernel Modules
#

KERNEL_3G_MODULES = " \
        kernel-module-ppp-async \
        kernel-module-ppp-deflate \
        kernel-module-ppp-synctty \
        kernel-module-ppp-generic \
        kernel-module-slhc \
        kernel-module-usbserial \
        "

KERNEL_WIFI_MODULES = " \
	kernel-module-ath9k-htc \
	kernel-module-carl9170 \
	kernel-module-prism2-usb \
	kernel-module-rt73usb \
	kernel-module-rt2500usb \
	kernel-module-rtl8192cu \
	kernel-module-rtl8187 \
	kernel-module-r8712u \
	kernel-module-w35und \
	kernel-module-zd1211rw \
	${@base_contains("MACHINE_FEATURES", "rt3070-legacy", "", "kernel-module-rt2800usb", d)} \
	kernel-module-llc \
        kernel-module-stp \
        kernel-module-bridge \
        kernel-module-hostap \
	"

KERNEL_DVB_MODULES = " \
	kernel-module-stv0297 \
	kernel-module-ds3000 \
	kernel-module-stb6100 \
	kernel-module-zl10039 \
	kernel-module-cx22700 \
	kernel-module-a8293 \
	kernel-module-af9013 \
	kernel-module-sp887x \
	kernel-module-mb86a20s \
	kernel-module-s5h1420 \
	kernel-module-drxk \
	kernel-module-mt312 \
	kernel-module-isl6423 \
	kernel-module-tda10023 \
	kernel-module-stv090x \
	kernel-module-cxd2820r \
	kernel-module-tda8083 \
	kernel-module-ec100 \
	kernel-module-dib9000 \
	kernel-module-tua6100 \
	kernel-module-dib7000m \
	kernel-module-stv6110x \
	kernel-module-rtl2832 \
	kernel-module-cx22702 \
	kernel-module-dib0090 \
	kernel-module-af9033 \
	kernel-module-stv0900 \
	kernel-module-tda10086 \
	kernel-module-cx24113 \
	kernel-module-it913x-fe \
	kernel-module-nxt6000 \
	kernel-module-lnbp22 \
	kernel-module-ix2505v \
	kernel-module-m88rs2000 \
	kernel-module-isl6405 \
	kernel-module-cx24116 \
	kernel-module-tda8261 \
	kernel-module-drxd \
	kernel-module-dib3000mb \
	kernel-module-stb0899 \
	kernel-module-l64781 \
	kernel-module-tda10071 \
	kernel-module-stv0367 \
	kernel-module-tda18271c2dd \
	kernel-module-ves1x93 \
	kernel-module-stv6110 \
	kernel-module-mb86a16 \
	kernel-module-cx24110 \
	kernel-module-lgs8gl5 \
	kernel-module-rtl2830 \
	kernel-module-dib8000 \
	kernel-module-dvb-pll \
	kernel-module-lgs8gxx \
	kernel-module-zl10353 \
	kernel-module-lnbp21 \
	kernel-module-stv0288 \
	kernel-module-tda665x \
	kernel-module-sp8870 \
	kernel-module-isl6421 \
	kernel-module-tda826x \
	kernel-module-dib7000p \
	kernel-module-s921 \
	kernel-module-atbm8830 \
	kernel-module-tda10021 \
	kernel-module-tda1004x \
	kernel-module-itd1000 \
	kernel-module-si21xx \
	kernel-module-stv0299 \
	kernel-module-cx24123 \
	kernel-module-stb6000 \
	kernel-module-tda10048 \
	kernel-module-mt352 \
	kernel-module-s5h1432 \
	kernel-module-dib0070 \
	kernel-module-dib3000mc \
	kernel-module-hd29l2 \
	kernel-module-zl10036 \
	kernel-module-ves1820 \
	kernel-module-mxl5005s \
	kernel-module-tuner-simple \
	kernel-module-fc2580 \
	kernel-module-tda8290 \
	kernel-module-tda9887 \
	kernel-module-tda18218 \
	kernel-module-fc0013 \
	kernel-module-fc0012 \
	kernel-module-fc0011 \
	kernel-module-mt20xx \
	kernel-module-mc44s803 \
	kernel-module-mt2131 \
	kernel-module-tea5761 \
	kernel-module-tuner-xc2028 \
	kernel-module-mt2060 \
	kernel-module-e4000 \
	kernel-module-max2165 \
	kernel-module-mt2063 \
	kernel-module-xc5000 \
	kernel-module-tuner-types \
	kernel-module-xc4000 \
	kernel-module-tua9001 \
	kernel-module-mxl5007t \
	kernel-module-tda18271 \
	kernel-module-tda18212 \
	kernel-module-tea5767 \
	kernel-module-qt1010 \
	kernel-module-mt2266 \
	kernel-module-tda827x \
	kernel-module-smsusb \
	kernel-module-au0828 \
	kernel-module-dvb-usb-v2 \
	kernel-module-dvb-usb-az6007 \
	kernel-module-dvb-usb-anysee \
	kernel-module-dvb-usb-mxl111sf \
	kernel-module-dvb-usb-gl861 \
	kernel-module-dvb-usb-ec168 \
	kernel-module-dvb-usb-it913x \
	kernel-module-mxl111sf-tuner \
	kernel-module-dvb-usb-ce6230 \
	kernel-module-dvb-usb-af9035 \
	kernel-module-dvb-usb-af9015 \
	kernel-module-dvb-usb-cypress-firmware \
	kernel-module-dvb-usb-au6610 \
	kernel-module-dvb-usb-rtl28xxu \
	kernel-module-mxl111sf-demod \
	kernel-module-b2c2-flexcop-usb \
	kernel-module-smsdvb \
	kernel-module-smsmdtv \
	kernel-module-b2c2-flexcop \
	kernel-module-tveeprom \
	"
```

## conf/machine/vuduo2.conf
```bitbake
#@TYPE: Machine
#@NAME: vuduo2
#@DESCRIPTION: Machine configuration for the VuPlus

TARGET_ARCH = "mipsel"

PREFERRED_VERSION_linux-vuduo2 = "3.3.8"
PREFERRED_VERSION_linux-libc-headers = "2.6.31"

PREFERRED_PROVIDER_virtual/kernel = "linux-${MACHINE}"

MACHINE_ESSENTIAL_EXTRA_RDEPENDS = "kernel vuplus-dvb-modules"

MACHINE_ESSENTIAL_EXTRA_RRECOMMENDS = "\
	kernel-module-ext2 \
	"

MACHINE_FEATURES += "ralink-legacy"
MACHINE_FEATURES += "ralink-kmod"
require conf/machine/include/vuplus-modules2.inc

MACHINE_ESSENTIAL_EXTRA_RDEPENDS += ${@base_contains('PREFERRED_VERSION_linux-vuduo2', '3.3.8', '${KERNEL_WIFI_MODULES}', '', d)}
MACHINE_ESSENTIAL_EXTRA_RDEPENDS += ${@base_contains('PREFERRED_VERSION_linux-vuduo2', '3.3.8', '${KERNEL_DVB_MODULES}', '', d)}
MACHINE_ESSENTIAL_EXTRA_RDEPENDS += ${@base_contains('PREFERRED_VERSION_linux-vuduo2', '3.3.8', '${KERNEL_3G_MODULES}', '', d)}


PREFERRED_VERSION_wpa-supplicant = "0.7.3"

IMAGE_FSTYPES = "tar.bz2 ubi"

TARGET_FPU = "hard"

MACHINE_FEATURES += "kernel26"

TARGET_CC_ARCH = "-march=mips32"

DISTRO_FEATURES += " mplt"

PREFERRED_PROVIDER_task-vuplus-dvbapi = "task-vuplus-dvbapi3"
PREFERRED_PROVIDER_task-vuplus-ui = "task-vuplus-enigma2"

GLIBC_ADDONS ?= "ports,nptl,libidn"
GLIBC_EXTRA_OECONF = "--disable-profile --with-tls --without-fp --with-__thread"

PREFERRED_PROVIDER_xserver = "xserver-kdrive"


MACHINE_FEATURES += "alsa pci"
MACHINE_FEATURES += "wifi"
MACHINE_FEATURES += "vuwlan"
MACHINE_FEATURES += "enable-rc-kbd"
MACHINE_FEATURES += "display-graphic-vfd"

UBI_VOLNAME = "rootfs"
MKUBIFS_ARGS = "-m 2048 -e 126976 -c 8192"
UBINIZE_ARGS = "-m 2048 -p 128KiB"

IMAGEDIR ?= "${MACHINE}"
EXTRA_IMAGECMD_COMPAT = " --eraseblock=0x20000 -n -l "

IMAGE_CMD_ubi_prepend = " \
        cp ${IMAGE_ROOTFS}/tmp/vmlinux.gz ${DEPLOY_DIR_IMAGE}/${IMAGE_NAME}.vmlinux.gz; \
        cp ${IMAGE_ROOTFS}/boot/initrd_cfe_auto.bin ${DEPLOY_DIR_IMAGE}/${IMAGE_NAME}.initrd_cfe_auto.bin; \
        cp ${IMAGE_ROOTFS}/boot/splash_cfe_auto.bin ${DEPLOY_DIR_IMAGE}/${IMAGE_NAME}.splash_cfe_auto.bin; \
        rm -f ${IMAGE_ROOTFS}/tmp/vmlinux.gz; \
        rm -f ${IMAGE_ROOTFS}/boot/initrd_cfe_auto.bin; \
        rm -f ${IMAGE_ROOTFS}/boot/splash_cfe_auto.bin; \
        "


IMAGE_CMD_ubi_append = "; \
        mkdir -p ${DEPLOY_DIR_IMAGE}/vuplus/duo2; \
        cp ${DEPLOY_DIR_IMAGE}/${IMAGE_NAME}.rootfs.ubi ${DEPLOY_DIR_IMAGE}/vuplus/duo2/root_cfe_auto.bin; \
	cp ${DEPLOY_DIR_IMAGE}/${IMAGE_NAME}.vmlinux.gz ${DEPLOY_DIR_IMAGE}/vuplus/duo2/kernel_cfe_auto.bin; \
	cp ${DEPLOY_DIR_IMAGE}/${IMAGE_NAME}.initrd_cfe_auto.bin ${DEPLOY_DIR_IMAGE}/vuplus/duo2/initrd_cfe_auto.bin; \
	cp ${DEPLOY_DIR_IMAGE}/${IMAGE_NAME}.splash_cfe_auto.bin ${DEPLOY_DIR_IMAGE}/vuplus/duo2/splash_cfe_auto.bin; \
	touch ${DEPLOY_DIR_IMAGE}/vuplus/duo2/reboot.update; \
        cd ${DEPLOY_DIR_IMAGE}; \
	zip ${IMAGE_NAME}_usb.zip vuplus/duo2/*; \
	rm -rf vuplus; \ 
        "
```

## conf/machine/vuuno.conf
```bitbake
#@TYPE: Machine
#@NAME: vuuno
#@DESCRIPTION: Machine configuration for the VuPlus

TARGET_ARCH = "mipsel"

PREFERRED_VERSION_linux-vuuno = "3.1.1"
PREFERRED_VERSION_linux-libc-headers = "2.6.31"

PREFERRED_PROVIDER_virtual/kernel = "linux-${MACHINE}"


MACHINE_ESSENTIAL_EXTRA_RDEPENDS_2.6.18 = "kernel vuplus-dvb-modules \
        kernel-module-isofs \
        kernel-module-sr-mod    kernel-module-usb-storage \
        kernel-module-cdrom \
        kernel-module-msdos kernel-module-vfat kernel-module-fat \
        kernel-module-libata kernel-module-ntfs kernel-module-sata-svw \
        kernel-module-nls-iso8859-15 kernel-module-nls-cp850 \
        kernel-module-nls-utf8 \
        kernel-module-i2c-core kernel-module-i2c-dev kernel-module-firmware-class kernel-module-input kernel-module-evdev \
        kernel-module-snd-pcm kernel-module-snd \
	kernel-module-tun \
	kernel-module-fb \
	v4l-dvb-module-dvb-core \
        kernel-module-usbhid \
        kernel-module-mousedev \
        "

MACHINE_ESSENTIAL_EXTRA_RRECOMMENDS_2.6.18 = "\
        kernel-module-cifs \
        kernel-module-exportfs \
        kernel-module-ext2 \
        kernel-module-reiserfs \
        kernel-module-xfs \
	"

MACHINE_ESSENTIAL_EXTRA_RDEPENDS_3.1.1 = "kernel vuplus-dvb-modules"

MACHINE_ESSENTIAL_EXTRA_RRECOMMENDS_3.1.1 = "\
        kernel-module-ext2 \
        "

MACHINE_ESSENTIAL_EXTRA_RDEPENDS = ${@base_contains('PREFERRED_VERSION_linux-vuuno', '2.6.18', '${MACHINE_ESSENTIAL_EXTRA_RDEPENDS_2.6.18}', '${MACHINE_ESSENTIAL_EXTRA_RDEPENDS_3.1.1}', d)}
MACHINE_ESSENTIAL_EXTRA_RRECOMMENDS = ${@base_contains('PREFERRED_VERSION_linux-vuuno', '2.6.18', '${MACHINE_ESSENTIAL_EXTRA_RRECOMMENDS_2.6.18}', '${MACHINE_ESSENTIAL_EXTRA_RRECOMMENDS_3.1.1}', d)}

require conf/machine/include/vuplus-modules.inc


TARGET_FPU = "hard"
MACHINE_FEATURES += "kernel26"

TARGET_CC_ARCH = "-march=mips32"

DISTRO_FEATURES += " mplt"

PREFERRED_PROVIDER_task-vuplus-dvbapi = "task-vuplus-dvbapi3"
PREFERRED_PROVIDER_task-vuplus-ui = "task-vuplus-enigma2"

GLIBC_ADDONS ?= "ports,nptl,libidn"
GLIBC_EXTRA_OECONF = "--disable-profile --with-tls --without-fp --with-__thread"

PREFERRED_PROVIDER_xserver = "xserver-kdrive"

EXTRA_IMAGEDEPENDS += "vuplus-makenfi-native"

MACHINE_FEATURES += "alsa pci"
MACHINE_FEATURES += "wifi"
MACHINE_FEATURES += "vuwlan"
MACHINE_FEATURES += "display-text-vfd"

UBI_VOLNAME = "rootfs"
MKUBIFS_ARGS = "-m 2048 -e 126976 -c 3984 -F"
UBINIZE_ARGS = "-m 2048 -p 128KiB"

IMAGEDIR ?= "${MACHINE}"
EXTRA_IMAGECMD_COMPAT = " --eraseblock=0x20000 -n -l "

IMAGE_CMD_ubi_append = "; \
        cp ${IMAGE_ROOTFS}/boot/vmlinux.gz ${DEPLOY_DIR_IMAGE}/${IMAGE_NAME}.vmlinux.gz; \
        cp ${IMAGE_ROOTFS}/boot/splash_cfe_auto.bin ${DEPLOY_DIR_IMAGE}/${IMAGE_NAME}.splash_cfe_auto.bin; \
        rm -f ${IMAGE_ROOTFS}/boot/vmlinux.gz; \
        rm -f ${IMAGE_ROOTFS}/boot/splash_cfe_auto.bin; \
        mkfs.jffs2 --root=${IMAGE_ROOTFS}/boot --faketime \
        --disable-compressor=lzo --compression-mode=size \
        --output=${DEPLOY_DIR_IMAGE}/${IMAGE_NAME}.boot.jffs2 \
        ${EXTRA_IMAGECMD_COMPAT}; \
        mkdir -p ${DEPLOY_DIR_IMAGE}/vuplus/uno; \
        cp ${DEPLOY_DIR_IMAGE}/${IMAGE_NAME}.rootfs.ubi ${DEPLOY_DIR_IMAGE}/vuplus/uno/root_cfe_auto.jffs2; \
        cp ${DEPLOY_DIR_IMAGE}/${IMAGE_NAME}.vmlinux.gz ${DEPLOY_DIR_IMAGE}/vuplus/uno/kernel_cfe_auto.bin; \
        cp ${DEPLOY_DIR_IMAGE}/${IMAGE_NAME}.splash_cfe_auto.bin ${DEPLOY_DIR_IMAGE}/vuplus/uno/splash_cfe_auto.bin; \
        cd ${DEPLOY_DIR_IMAGE}; \
        zip ${IMAGE_NAME}_usb.zip vuplus/uno/*; \
        rm -rf vuplus; \
        "
```
